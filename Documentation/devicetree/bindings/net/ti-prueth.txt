## Documentation/devicetree/bindings/net/ti-prueth.txt
```
Texas Instruments PRUSS Ethernet MAC
====================================

Required properties:
- compatible       : Should be one of the following,
                        "ti,am3359-prueth" for AM335x SoCs
                        "ti,am4376-prueth" for AM437x SoCs
                        "ti,am57-prueth" for AM57xx SoCs
                        "ti,k2g-prueth" for 66AK2G SoCs

- prus             : list of pHandles to the PRU nodes
- firmware-name	   : list of strings containing firmware path.
- sram	           : pHandle to OCMC SRAM node
- interrupt-parent : pHandle to the PRUSS INTC node
- rx-queue-size    : Array of queue sizes in rx direction (Ingress)
                     Format /bits/ 16 <q1 q2 q3 q4 colq>
- tx-queue-size    : Array of queue sizes in tx direction (Egress)
                     Format /bits/ 16 <q1 q2 q3 q4 colq>

NOTE for rx-queue-size
    For EMAC and Switch/HSR/PRP, only the first 4 q sizes take
    effect. The 5th (if present) will be ignored.
NOTE for tx-queue-size
    For EMAC, only the first 4 q sizes take effect.
    The 5th (if present) will be ignored.
    For Switch/HSR/PRP, all 5 q sizes take effect.
    All 5 must present if need to config q sizes.

    If no q size config exists for a particular port in
    dts, the following defaults for that port will
    be used.

    HSR/PRP Defaults:
    host: rx-queue-size = /bits/ 16 <206 206 206 206 0>
    mii0: tx-queue-size = /bits/ 16 <97 97 97 97 48>
    mii1: tx-queue-size = /bits/ 16 <97 97 97 97 48>

    EMAC Defaults:
    host: rx-queue-size = /bits/ 16 <194 194 194 194 0>
    mii0: tx-queue-size = /bits/ 16 <97 97 97 97 48>
    mii1: tx-queue-size = /bits/ 16 <97 97 97 97 48>

Must contain children, one for each of the MAC ports.
Children must be named ethernet-mii0 and ethernet-mii1.
Either one or both children can be present. If only one
child is present driver operates in single EMAC mode.

For single mode operation with the 2nd PRU, you still need
to provide both PRUs and firmware-names but the firmware-name
for the first PRU can be NULL. See 2nd example.

Required properties for children:
- phy-handle       : See ethernet.txt file in the same directory.
- phy-mode         : See ethernet.txt file in the same directory.
- interrupt-names  : should be "rx" and "tx"
- interrupts       : should contain an array of PRUSS system event
                     numbers used as the interrupt sources for Rx
                     and Tx respectively.

Optional properties for children:
- local-mac-address	: mac address for the port.

Example (am572x-idk board, dual-emac):
======================================
	pruss2_eth {
		compatible = "ti,am57-prueth";
		prus = <&pru2_0>, <&pru2_1>;
		firmware-name = "ti-pruss/am57xx-pru0-prueth-fw.elf",
				"ti-pruss/am57xx-pru1-prueth-fw.elf";
		sram = <&ocmcram1>;
		interrupt-parent = <&pruss2_intc>;

		pruss2_emac0: ethernet-mii0 {
			phy-handle = <&pruss2_eth0_phy>;
			phy-mode = "mii";
			interrupts = <20>, <22>;
			interrupt-names = "rx", "tx";
			/* Filled in by bootloader */
			local-mac-address = [00 00 00 00 00 00];
		};

		pruss2_emac1: ethernet-mii1 {
			phy-handle = <&pruss2_eth1_phy>;
			phy-mode = "mii";
			interrupts = <21>, <23>;
			interrupt-names = "rx", "tx";
			/* Filled in by bootloader */
			local-mac-address = [00 00 00 00 00 00];
		};
	};

Example (am572x-idk board, single-emac):
=======================================
	pruss2_eth {
		compatible = "ti,am57-prueth";
		prus = <&pru2_0>, <&pru2_1>;
		firmware-name = "",
				"ti-pruss/am57xx-pru1-prueth-fw.elf";
		sram = <&ocmcram1>;
		interrupt-parent = <&pruss2_intc>;

		pruss2_emac1: ethernet-mii1 {
			phy-handle = <&pruss2_eth1_phy>;
			phy-mode = "mii";
			interrupts = <21>, <23>;
			interrupt-names = "rx", "tx";
			/* Filled in by bootloader */
			local-mac-address = [00 00 00 00 00 00];
		};
	};
```
